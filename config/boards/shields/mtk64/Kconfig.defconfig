## config/boards/shields/mtk64/Kconfig.defconfig
```kconfig
if SHIELD_MTK64_R

config ZMK_KEYBOARD_NAME
    default "mtk64"

config ZMK_SPLIT
    default y

config ZMK_POINTING
    default y

endif

if SHIELD_MTK64_L

config ZMK_KEYBOARD_NAME
    default "mtk64"

config ZMK_SPLIT
    default y

endif

if SHIELD_MTK64_DONGLE

config ZMK_KEYBOARD_NAME
    default "mtk64"

config ZMK_SPLIT
    default y

config ZMK_SPLIT_ROLE_CENTRAL
    default y

config ZMK_POINTING
    default y

config ZMK_BATTERY
    bool
    default y

endif

if SHIELD_MTK64_FOOT

config ZMK_KEYBOARD_NAME
    default "mtk64"

config ZMK_SPLIT
    default y

endif

if SHIELD_MTK64_LEFTBALL_L

config ZMK_KEYBOARD_NAME
    default "mtk64"

config ZMK_SPLIT
    default y

config ZMK_POINTING
    default y

endif

if SHIELD_MTK64_LEFTBALL_R

config ZMK_KEYBOARD_NAME
    default "mtk64"

config ZMK_SPLIT
    default y

endif
```

## config/boards/shields/mtk64/Kconfig.shield
```kconfig
config SHIELD_MTK64_R
    def_bool $(shields_list_contains,mtk64_R)

config SHIELD_MTK64_L
    def_bool $(shields_list_contains,mtk64_L)

config SHIELD_MTK64_FOOT
    def_bool $(shields_list_contains,mtk64_FOOT)

config SHIELD_MTK64_LEFTBALL_L
    def_bool $(shields_list_contains,mtk64_leftball_L)

config SHIELD_MTK64_LEFTBALL_R
    def_bool $(shields_list_contains,mtk64_leftball_R)

menu "MTK64 Trackball Rate Limit"

config ZMK_TRACKBALL_REPORT_INTERVAL_USB_US
    int "USB trackball report interval (microseconds)"
    default 1000
    help
      Report interval for USB in microseconds (default: 1000us = 1ms / 1000Hz).

config ZMK_TRACKBALL_REPORT_INTERVAL_BLE_US
    int "BLE trackball report interval (microseconds)"
    default 7000
    help
      Report interval for BLE in microseconds (default: 7000us = 7.0ms / 133.3Hz slot sync).

endmenu
```

## config/boards/shields/mtk64/dts/bindings/behaviors/zmk,behavior-aml.yaml
```yaml
# Copyright (c) 2026 The ZMK Contributors
# SPDX-License-Identifier: MIT

description: Behavior to control Auto Mouse Layer (AML) ON/OFF state

compatible: "zmk,behavior-aml"

include: zero_param.yaml

properties:
  cmd:
    type: int
    required: true
    enum:
      - 0 # TOG
      - 1 # ON
      - 2 # OFF
    description: |
      Command type:
      0: Toggle AML state
      1: Turn AML ON
      2: Turn AML OFF
```

## config/boards/shields/mtk64/dts/bindings/behaviors/zmk,behavior-paw32xx-cpi.yaml
```yaml
# Copyright (c) 2026 The ZMK Contributors
# SPDX-License-Identifier: MIT

description: Behavior to control PAW3222 CPI resolution

compatible: "zmk,behavior-paw32xx-cpi"

include: zero_param.yaml

properties:
  cmd:
    type: int
    required: true
    enum:
      - 0 # INC
      - 1 # DEC
      - 2 # SET
    description: |
      Command type:
      0: Increase CPI
      1: Decrease CPI
      2: Set explicit CPI value

  val:
    type: int
    required: false
    description: Explicit CPI value when cmd is 2 (SET).
```

## config/boards/shields/mtk64/dts/bindings/behaviors/zmk,behavior-scroll-inverter.yaml
```yaml
# Copyright (c) 2026 The ZMK Contributors
# SPDX-License-Identifier: MIT

description: Behavior to control trackball scroll inversion state

compatible: "zmk,behavior-scroll-inverter"

include: zero_param.yaml

properties:
  cmd:
    type: int
    required: true
    enum:
      - 0 # TOG
      - 1 # NORMAL
      - 2 # INVERTED
    description: |
      Command type:
      0: Toggle scroll inversion state
      1: Set normal scroll
      2: Set inverted scroll
```

## config/boards/shields/mtk64/dts/bindings/input_processors/zmk,input-processor-aml.yaml
```yaml
# Copyright (c) 2026 The ZMK Contributors
# SPDX-License-Identifier: MIT

description: Input Processor for Auto Mouse Layer with toggle support

compatible: "zmk,input-processor-aml"

include: ip_two_param.yaml

properties:
  require-prior-idle-ms:
    type: int
    required: false
    default: 0
    description: Time in milliseconds that must pass after the last keystroke before the layer can be toggled

  excluded-positions:
    type: array
    required: false
    default: []
    description: Array of key positions that will NOT trigger layer deactivation when pressed
```

## config/boards/shields/mtk64/dts/bindings/input_processors/zmk,input-processor-dynamic-rate-limit.yaml
```yaml
# Copyright (c) 2026 The ZMK Contributors
# SPDX-License-Identifier: MIT

description: Dynamic input processor for switching report rate between USB and BLE transports

compatible: "zmk,input-processor-dynamic-rate-limit"

include: ip_two_param.yaml

properties:
  type:
    type: int
  codes:
    type: array
    required: true
```

## config/boards/shields/mtk64/dts/bindings/input_processors/zmk,input-processor-scroll-inverter.yaml
```yaml
# Copyright (c) 2026 The ZMK Contributors
# SPDX-License-Identifier: MIT

description: Input Processor for inverting trackball scroll direction

compatible: "zmk,input-processor-scroll-inverter"

include: ip_zero_param.yaml
```

## config/west.yml
```yaml
manifest:
  remotes:
    - name: zmkfirmware
      url-base: https://github.com/zmkfirmware
    - name: mentako-ya
      url-base: https://github.com/mentako-ya
    - name: sekigon-gonnoc
      url-base: https://github.com/sekigon-gonnoc
    - name: badjeff
      url-base: https://github.com/badjeff
    - name: caksoylar
      url-base: https://github.com/caksoylar
    - name: englmaxi
      url-base: https://github.com/englmaxi
    - name: nrfconnect
      url-base: https://github.com/nrfconnect
  projects:
    - name: zmk
      remote: zmkfirmware
      revision: main
      import: app/west.yml
    - name: zmk-input-processor-xyz
      remote: badjeff
      revision: main
    - name: zmk-input-processor-report-rate-limit
      remote: badjeff
      revision: main
    - name: zmk-rgbled-widget
      remote: caksoylar
      revision: main
    - name: zmk-dongle-display
      remote: mentako-ya
      revision: mtk64_rev4
    - name: zmk-feature-split-esb
      remote: badjeff
      revision: main
    - name: sdk-nrf
      remote: badjeff
      revision: v3.1-branch+zmk-fixes
      path: nrf
    - name: nrfxlib
      remote: nrfconnect
      revision: v3.1-branch
      repo-path: sdk-nrfxlib
      path: nrfxlib
  self:
    path: config
```
